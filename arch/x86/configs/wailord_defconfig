## drivers/staging/acpi_call/Kconfig
```kconfig
menu "ACPI"

config ACPI_CALL
	tristate "Enables calls to ACPI methods through /proc/acpi/call" 
	default n
	help
		A kernel simple module that enables you to call ACPI methods by writing the method name 
		followed by arguments to /proc/acpi/call.
		This module is to be considered a proof-of-concept and has been superseeded by projects like 
		bbswitch. It allows you to tamper with your system and should be used with caution.
```

## drivers/staging/bbswitch/Kconfig
```kconfig
config BBSWITCH
	tristate "Dynamically Disable Discreet Nvidia Graphics"
	default n
	help
	  bbswitch is a kernel module which automatically detects the required ACPI calls for two kinds of Optimus laptops. It has been verified to work with "real" Optimus and "legacy" Optimus laptops (at least, that is how I call them).
 
```

## drivers/staging/tp_smapi/Kconfig
```kconfig
config THINKPAD_EC
	tristate
	---help---
	  This is a low-level driver for accessing the ThinkPad H8S embedded
	  controller over the LPC bus (not to be confused with the ACPI Embedded
	  Controller interface).
	  
config TP_SMAPI
	tristate "ThinkPad SMAPI Support"
	select THINKPAD_EC
	default n
	help
	  This adds SMAPI support on Lenovo/IBM ThinkPads, for features such
	  as battery charging control. For more information about this driver
	  see <http://www.thinkwiki.org/wiki/tp_smapi>.
	  If you have a Lenovo/IBM ThinkPad laptop, say Y or M here.
```
